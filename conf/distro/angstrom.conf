## conf/distro/angstrom.conf
```bitbake
#@--------------------------------------------------------------------
#@TYPE: Distribution
#@NAME: Angstrom <http://www.angstrom-distribution.org>
#@DESCRIPTION: The Linux Distribution for Kernel 2.6+ based devices
#@MAINTAINER: Graeme 'XorA' Gregory <dp@xora.org.uk>
#@MAINTAINER: Koen Kooi <koen@openembedded.org>
#@MAINTAINER: Khem Raj <raj.khem@gmail.com>
#@MAINTAINER: Philip 'Crofton' Balister <philip@balister.org>
#@--------------------------------------------------------------------

# This is a aimed to be the next stable angstrom release.
# If you want something stable *right now*, use angstrom-v2013.12
#
# Use this at your own risk, we welcome bugreports sent to
#    angstrom-distro-devel@linuxtogo.org
#
# For more contact info please visit
#    http://www.angstrom-distribution.org/contact
#
# Again, in doubt, use the master branch of setup-scripts

DISTRO_VERSION = "v${@time.strftime('%Y.%m',time.gmtime())}"

#Images built can have to modes:
# 'debug': empty rootpassword, strace included
# 'release' no root password, no strace and gdb by default
DISTRO_TYPE ?= "debug"
#DISTRO_TYPE = "release"

# Set the toolchain type (internal, external) and brand (generic, csl etc.)
TOOLCHAIN_TYPE ?= "internal"
TOOLCHAIN_BRAND ?= ""

# Ship just basic locale by default. Locales are big (~1Mb uncompr.), so
# shipping some adhoc subset will be still useless and size burden for
# users of all other languages/countries. Instead, worth to make it easy
# to install additional languages: installer/wizard + metapackages which
# will RRECOMMEND as much as possible content for a given language
# (locales, UI transalations, help, etc. - useless for pros, but really 
# helpful for common users).
# Also, it appears that no locales fit in 16Mb for now. "C" locale rules!
ROOT_FLASH_SIZE ??= "32"
IMAGE_LINGUAS ?= '${@oe.utils.less_or_equal("ROOT_FLASH_SIZE", "16", "", "en-us", d)}'

# set feed path variables
FEED_BASEPATH = "feeds/next/${ANGSTROM_PKG_FORMAT}/${TCLIBC}/"


PREFERRED_PROVIDER_dbus-glib                     = "dbus-glib"
PREFERRED_PROVIDER-gconf-dbus                    = "gconf"
PREFERRED_PROVIDER_hotplug                       = "systemd"
PREFERRED_PROVIDER_opkg                          ?= "opkg"
PREFERRED_PROVIDER_opkg-native                   ?= "opkg-native"

# Prefer gummiboot over grub
EFI_PROVIDER                                     = "gummiboot"

# blacklist policy

PNBLACKLIST[pn-fso-apm]       = "regular apmd is good enough"
PNBLACKLIST[gconf-dbus]        = "gconf-dbus has been merged back into main GConf"
PNBLACKLIST[gconf-dbus-native] = "gconf-dbus has been merged back into main GConf"

require conf/distro/include/angstrom.inc

# uncomment to enable security flags - images tested had issues
#require conf/distro/include/security_flags.inc

# Prefer openssh over dropbear
TASK_BASIC_SSHDAEMON = "openssh-ssh openssh-sshd openssh-scp openssh-sftp openssh-sftp-server"

# Toolchain virtuals:
require conf/distro/include/toolchain-${TOOLCHAIN_TYPE}.inc

# Processor specific tunes like hard float ABI
include conf/distro/include/${TARGET_ARCH}-defaults.inc

# If we're using an .ipk based rootfs, we want to have opkg installed so postinst script can run
# We also take this opportunity to inject angstrom-version
IPKG_VARIANT = "opkg angstrom-version"

# Select xserver-xorg as default, since kdrive has been EOL'ed
XSERVER ?= "xserver-xorg xf86-input-evdev xf86-input-keyboard xf86-input-mouse xf86-video-fbdev"

# do some packagegroup-base stuff here

# Prefer bluez4, it's needed for things like connman. Bluez4 is also largely backward compatible with
# bluez 3.x
DISTRO_BLUETOOTH_MANAGER = "\
	blueprobe \
	bluez5 \
   "

# We want to ship extra debug utils in the rootfs when doing a debug build
DEBUG_APPS ?= ""
DEBUG_APPS += '${@oe.utils.conditional("DISTRO_TYPE", "release", "", "strace procps",d)}'

# util-linux-mount util-linux-umount: busybox mount is broken
DISTRO_EXTRA_RDEPENDS += " \
    angstrom-version \
    util-linux-mount util-linux-umount \
"

# This also hooks into packagegroup-base, but isn't mandatory.
# If you don't want parts of this in your packagegroup-base using images you can put this in the image recipe:
# BAD_RECOMMENDATIONS = "avahi-daemon avahi-autoipd"
# Note that BAD_RECOMMENDATIONS is a feature of rootfs_ipk.bbclass, not angstrom
# kernel modules: ship fs modules so you can mount stuff and af-packet so networking works
# avahi: makes finding your device on the network a lot easier
# openssh-sftp-server: provides sftp which combined with avahi makes it real easy to use things like sshfs
# psplash-angstrom: angstrom branded psplash, you can add your own psplash-foo to an image, it uses update-alternatives
# DEBUG_APPS: ship strace and procpc to make simple debugging a lot easier
DISTRO_EXTRA_RRECOMMENDS += " \
    kernel-module-vfat \
    kernel-module-ext2 \
    kernel-module-ext3 \
    kernel-module-af-packet \
    avahi-daemon \
    avahi-autoipd \
    openssh-sftp-server \
    ${DEBUG_APPS} \
"

# workaround oe-core long lasting bulls.. 049f89155b1e80875aad6e53b21808b827c06915
# make x11-base a valid IMAGE_FEATURES again
IMAGE_FEATURES[validitems] += "x11-base"
```

## conf/distro/include/angstrom-core-tweaks.inc
```bitbake
# This include is to import changes from OE that are hard to overlay into core

# Default hash policy for distro
BB_SIGNATURE_HANDLER ?= "OEBasicHash"

# The network based PR service host and port
# Uncomment the following lines to enable PRservice.
# Set PRSERV_HOST to 'localhost' and PRSERV_PORT to '0' to automatically
# start local PRService.
# Set to other values to use remote PRService.
#PRSERV_HOST ?= "localhost"
#PRSERV_PORT ?= "0"
 

# Empty commercial license, we want to build a superset for the default config
COMMERCIAL_LICENSE = ""
LICENSE_FLAGS_WHITELIST += "commercial"

# Unbreak multimachine builds
LICENSE_DIRECTORY = "${DEPLOY_DIR}/licenses/${MACHINE_ARCH}"

# Preset set this or bbappends break
PRINC ??= "0"

# Shared state fixups
MACHINEOVERRIDES[vardepsexclude] += "SOC_FAMILY"

# opkg
EXTRA_IMAGE_FEATURES ?= "package-management empty-root-password"

PREFERRED_PROVIDER_os-release = "angstrom-version"

# Prefer libjpeg-turbo
PREFERRED_PROVIDER_jpeg = "libjpeg-turbo"
PREFERRED_PROVIDER_jpeg-native = "libjpeg-turbo-native"

# Prefer the one from meta-oe over the one in oe-core
PREFERRED_PROVIDER_virtual/libx11 = "libx11"
PREFERRED_PROVIDER_virtual/xserver-xf86 = "xserver-xorg"
PREFERRED_PROVIDER_virtual/xserver = "xserver-xorg"

#
# udev, devfsd, busybox-mdev (from busybox) or none
#
IMAGE_DEV_MANAGER ?= "udev"
#
# sysvinit, upstart, systemd
#
IMAGE_INIT_MANAGER ?= "systemd"
IMAGE_INITSCRIPTS ?= "systemd-compat-units"
#
# busybox, getty
#
IMAGE_LOGIN_MANAGER ?= "busybox"

IMAGE_KEEPROOTFS ?= ""
IMAGE_KEEPROOTFS[doc] = "Set to non-empty to keep ${IMAGE_ROOTFS} around after image creation."

IMAGE_BOOT ?= "${IMAGE_INITSCRIPTS} \
               ${IMAGE_DEV_MANAGER} \
               ${IMAGE_INIT_MANAGER} \
               ${IMAGE_LOGIN_MANAGER}"

# some default locales
IMAGE_LINGUAS ?= "de-de fr-fr en-gb"

IMAGE_INSTALL += "${IMAGE_BOOT}"

# Layer tweaks

# SDK stuff

PREFERRED_PROVIDER_libltdl-dev = "libtool"
PREFERRED_PROVIDER_libtool = "libtool"
```

## conf/distro/include/angstrom-jalimo.conf
```bitbake
# Put a 'require conf/distro/include/angstrom-jalimo.conf' in your local.conf if you want to build from the jalimo overlay

# Possible provider: cacao-native and jamvm-native
PREFERRED_PROVIDER_virtual/java-native = "jamvm-native"

# Optional since there is only one provider for now
PREFERRED_PROVIDER_virtual/javac-native = "ecj-bootstrap-native"

# Target VM
PREFERRED_PROVIDER_classpath = "classpath"
```

## conf/distro/include/angstrom-java.inc
```bitbake
# Set PREFFERED and VERSION stuff for working java runtime

PREFERRED_PROVIDER_java2-vm = "${DEFAULTJRE}"
PREFERRED_PROVIDER_java2-runtime = "${DEFAULTJRE}"
PREFERRED_PROVIDER_openjdk-7-jre = "${DEFAULTJRE}"
# Possible provider: cacao-initial-native and jamvm-initial-native
PREFERRED_PROVIDER_virtual/java-initial-native = "cacao-initial-native"

DEFAULTJRE ?= "openjdk-7-jre"
```

## conf/distro/include/mortsgna-core-tweaks.inc
```bitbake
# This include is to import changes from OE that are hard to overlay into core

# Default hash policy for distro
BB_SIGNATURE_HANDLER ?= "OEBasicHash"

# Empty commercial license, we want to build a superset for the default config
LICENSE_FLAGS_WHITELIST += "commercial"

# Unbreak multimachine builds
LICENSE_DIRECTORY = "${DEPLOY_DIR}/licenses/${MACHINE_ARCH}"

# Shared state fixups
MACHINEOVERRIDES[vardepsexclude] += "SOC_FAMILY"
```

## conf/distro/include/mortsgna-distro-features.inc
```bitbake
# We want images supporting the following features (for packagegroup(-core)-base)
DISTRO_FEATURES = "alsa argp bluetooth ext2 ipv4 ipv6 irda largefile nfs pam pci pcmcia ppp smbfs systemd usbgadget usbhost vfat wifi xattr zeroconf gobject-introspection-data"

# Disable sysvinit for recipes with systemd support
DISTRO_FEATURES_BACKFILL_CONSIDERED += "sysvinit"
VIRTUAL-RUNTIME_init_manager = "systemd"
# Uncomment to completely disable support for sysv scripts:
#PACKAGECONFIG_pn-systemd = "xz"

# USE-flag like features
DISTRO_FEATURES += "tk"
DISTRO_FEATURES += "x11"
DISTRO_FEATURES += "3g"
DISTRO_FEATURES += "pulseaudio"
DISTRO_FEATURES += "ldconfig"
DISTRO_FEATURES += "polkit"

# OpenGL support
DISTRO_FEATURES += "opengl"

# wayland...
DISTRO_WAYLAND = "wayland"

# No wayland for vivante blobs
DISTRO_WAYLAND_mx6 = ""
DISTRO_WAYLAND_mx7 = ""
DISTRO_WAYLAND_mx8 = ""
DISTRO_WAYLAND_use-mainline-bsp = "wayland"

DISTRO_FEATURES += "${DISTRO_WAYLAND}"

# Inherit the default LIBC features superset from OE-core
DISTRO_FEATURES += "${DISTRO_FEATURES_LIBC}"
```

## conf/distro/include/mortsgna-glibc.inc
```bitbake
# glibc:
PNBLACKLIST[libiconv] = "the glibc provided iconv library is used"

TARGET_OS = "linux"

# sane-toolchain.inc has this, and explains the GNU and ABI suffices:
#TARGET_OS = "${@compute_os_portion_of_target_triplet(d)}"

TARGET_OS .= "${@['','-gnueabi'][d.getVar('TARGET_ARCH',d,1) in ['arm', 'armeb']]}"
TARGET_OS .= "${@['','-gnuspe'][d.getVar('TUNE_PKGARCH',d,1) in ['ppce500', 'ppce500v2']]}"

# perl has some problems, see http://bugs.openembedded.net/show_bug.cgi?id=1616
# [23:00] oxo: glibc (any version) on sparc does not like (repeat me) "-Os"

TARGET_LINK_HASH_STYLE = "${@['-Wl,--hash-style=gnu',''][d.getVar('TARGET_ARCH',d,1) in ['mips', 'mipsel', 'mips64', 'mips64el']]}"
```

## conf/distro/include/mortsgna-image-logfile-volatile.inc
```bitbake
# override bitbake.conf default
VOLATILE_LOG_DIR = "false"

IMAGE_FEATURES[validitems] += "volatile-log"

# Do alignment on journal and /var/log
ROOTFS_POSTPROCESS_COMMAND += "postinst_volatile_log; "

postinst_volatile_log () {
    if [ "${@bb.utils.contains_any('IMAGE_FEATURES', 'volatile-log read-only-rootfs', '1', '0', d)}" = "1" ]; then
        # systemd journal
        if [ -f "${IMAGE_ROOTFS}${sysconfdir}/systemd/journald.conf" ]; then
            sed -i \
                -e 's:.*Storage=.*:Storage=volatile:g' \
                ${IMAGE_ROOTFS}${sysconfdir}/systemd/journald.conf
        fi
        # link /var/log -> /run/log
        if [ -e ${IMAGE_ROOTFS}${localstatedir}/log ]; then
             rm -rf ${IMAGE_ROOTFS}${localstatedir}/log
        fi
        ln -sf ../run/log ${IMAGE_ROOTFS}${localstatedir}/log
    fi
}
```

## conf/distro/include/mortsgna-inherits.inc
```bitbake
# use debian style naming
INHERIT += "debian"

# activate config checker
INHERIT += "sanity"

# make devshell available as task
INHERIT += "devshell"

# run QA tests on builds and packages and log them
INHERIT += "insane"

# run QA tests on recipes
#INHERIT += "recipe_sanity"

# have a shared state a.k.a package-staging2
INHERIT += "sstate"

# drop buildinfo to /etc/build
INHERIT += "image-buildinfo-mortsgna"
```

## conf/distro/include/mortsgna-libc-musl.inc
```bitbake
# musl:

# The things musl can provide.  We default to wanting musl to provide them.
# libc settings
DISTRO_FEATURES += "${@['', ' nls'][d.getVar('ENABLE_BINARY_LOCALE_GENERATION', 1) == '1']}"

USE_NLS_glib-2.0 = "yes"
USE_NLS_glib-2.0-native = "yes"
USE_NLS_gcc-cross = "no"
```

## conf/distro/include/mortsgna-preferred-providers.inc
```bitbake
# common
PREFERRED_PROVIDER_hotplug                       = "systemd"
PREFERRED_PROVIDER_virtual/gettext               ??= "gettext"
PREFERRED_PROVIDER_linux-libc-headers-nativesdk  = "linux-libc-headers-nativesdk"

# Prefer libjpeg-turbo
PREFERRED_PROVIDER_jpeg = "libjpeg-turbo"
PREFERRED_PROVIDER_jpeg-native = "libjpeg-turbo-native"

# Prefer gummiboot over grub
EFI_PROVIDER                                     = "gummiboot"

# X11
PREFERRED_PROVIDER_virtual/libx11 = "libx11"
PREFERRED_PROVIDER_virtual/xserver-xf86 = "xserver-xorg"
PREFERRED_PROVIDER_virtual/xserver = "xserver-xorg"

# Select xserver-xorg and common drivers as default
XSERVER ?= " \
    xserver-xorg \
    xf86-input-libinput \
    xf86-video-modesetting \
"

# Follow meta-java README:
# Possible provider: cacao-initial-native and jamvm-initial-native
PREFERRED_PROVIDER_virtual/java-initial-native = "cacao-initial-native"

# Possible provider: cacao-native and jamvm-native
PREFERRED_PROVIDER_virtual/java-native = "jamvm-native"

# Optional since there is only one provider for now
PREFERRED_PROVIDER_virtual/javac-native = "ecj-bootstrap-native"
```

## conf/distro/include/mortsgna.inc
```bitbake
# Preserve original DISTRO value
USERDISTRO := "${DISTRO}"
DISTRO = "mortsgna"
DISTRO_NAME = "Mortsgna"

BUILDNAME = "Mortsgna ${DISTRO_VERSION}"

TARGET_VENDOR = "-mortsgna"
SDK_VENDOR = "-mortsgnasdk"

# Yocto work around for missing ONLINE_PACKAGE_MANAGEMENT support
ONLINE_PACKAGE_MANAGEMENT = "full"

# Can be "glibc" or "musl"
TCLIBC ?= "glibc"

PREFERRED_PROVIDER_virtual/gettext ??= "gettext"
PREFERRED_PROVIDER_linux-libc-headers-nativesdk = "linux-libc-headers-nativesdk"

require conf/distro/include/mortsgna-${TCLIBC}.inc

# thumb2 only
ARM_INSTRUCTION_SET ??= "thumb"
ARM_INSTRUCTION_SET_armv4 ?= "arm"
ARM_INSTRUCTION_SET_armv5 ?= "arm"
ARM_INSTRUCTION_SET_armv6 ?= "arm"

# set MORTSGNA_ARMV7_TUNE="1" in your local.conf to build armv7athf
require conf/distro/include/mortsgna-armv7-tune.inc
DEFAULTTUNE_mortsgna := "${@armv7_tune_handler(d)}"


require conf/distro/include/mortsgna-inherits.inc

# Generate locales on the buildsystem instead of on the target. Speeds up first boot, set to "1" to enable
ENABLE_BINARY_LOCALE_GENERATION ?= "1"

# build UTF8 locales only
LOCALE_UTF8_ONLY = "1"

# qemu doesn't like this fp
ENABLE_BINARY_LOCALE_GENERATION_ep9312 = "0"

# qemu has taken a dislike to armeb as well
ENABLE_BINARY_LOCALE_GENERATION_armeb = "0"

# Name the generated images in a sane way
IMAGE_NAME = "${DISTRO_NAME}-${IMAGE_BASENAME}-${TCLIBC}-${IMAGE_PKGTYPE}-${DISTRO_VERSION}-${MACHINE}"
DEPLOY_DIR_IMAGE = "${DEPLOY_DIR}/images/${MACHINE}"

# Prefer ext4 images where possible
SDIMG_ROOTFS_TYPE = "ext4"

require conf/distro/include/mortsgna-distro-features.inc

# image specific volatile logfile handlding with image feature 'volatile-log'
require conf/distro/include/mortsgna-image-logfile-volatile.inc

# Yocto tweaks
require conf/distro/include/mortsgna-core-tweaks.inc
```
